## configs/linxdot_ld1001_defconfig
```kconfig
# Architecture
BR2_aarch64=y

# Toolchain
BR2_TOOLCHAIN_BUILDROOT_GLIBC=y
BR2_TOOLCHAIN_BUILDROOT_CXX=y

# Kernel — not built (Phase 1/3 uses prebuilt 5.15.104)
# BR2_LINUX_KERNEL is not set

# U-Boot — built from source (Phase 3)
BR2_TARGET_UBOOT=y
BR2_TARGET_UBOOT_BUILD_SYSTEM_KCONFIG=y
BR2_TARGET_UBOOT_BOARD_DEFCONFIG="quartz64-a-rk3566"
BR2_TARGET_UBOOT_CUSTOM_VERSION=y
BR2_TARGET_UBOOT_CUSTOM_VERSION_VALUE="2024.04"
BR2_TARGET_UBOOT_CONFIG_FRAGMENT_FILES="$(BR2_EXTERNAL_LINXDOT_PATH)/board/linxdot/uboot/linxdot.fragment"
BR2_TARGET_UBOOT_NEEDS_DTC=y
BR2_TARGET_UBOOT_NEEDS_PYLIBFDT=y
BR2_TARGET_UBOOT_NEEDS_PYELFTOOLS=y
BR2_TARGET_UBOOT_NEEDS_OPENSSL=y
BR2_TARGET_UBOOT_NEEDS_GNUTLS=y
BR2_TARGET_UBOOT_NEEDS_ATF_BL31=y
BR2_TARGET_UBOOT_NEEDS_ATF_BL31_ELF=y
BR2_TARGET_UBOOT_NEEDS_ROCKCHIP_RKBIN=y
# Modern Rockchip U-Boot emits a unified u-boot-rockchip.bin (SPL + FIT w/ BL31 + u-boot).
# Do not select FORMAT_ITB / SPL_NAME — the unified blob is installed via
# the NEEDS_ROCKCHIP_RKBIN post-install hook and written at offset 32K.

# TF-A — source build is force-selected by BR2_TARGET_UBOOT_NEEDS_ATF_BL31 above.
# Kept enabled for that reason, but the BL31 it produces is OVERRIDDEN at the
# U-Boot make step by ROCKCHIP_RKBIN_BL31_FILENAME (see below). TF-A v2.12.0
# lacks the Rockchip-vendor SIP SMCs that the vendor 5.15 kernel calls into —
# swapping in rkbin's rk3568_bl31_v1.45.elf unblocks Linux boot. Revisit when
# Phase 2 (mainline kernel from source) lands and we no longer need those SMCs.
BR2_TARGET_ARM_TRUSTED_FIRMWARE=y
BR2_TARGET_ARM_TRUSTED_FIRMWARE_CUSTOM_VERSION=y
BR2_TARGET_ARM_TRUSTED_FIRMWARE_CUSTOM_VERSION_VALUE="v2.12.0"
BR2_TARGET_ARM_TRUSTED_FIRMWARE_PLATFORM="rk3568"
BR2_TARGET_ARM_TRUSTED_FIRMWARE_BL31=y
# Rockchip TF-A emits bl31.elf (not *.bin); U-Boot consumes ELF directly.
BR2_TARGET_ARM_TRUSTED_FIRMWARE_IMAGES="bl31/bl31.elf"

# Rockchip proprietary firmware blobs (see FSD §3.3, §10.1):
#   - DDR init TPL (required for RK356x DRAM bring-up)
#   - Vendor BL31 (overrides TF-A's — same rkbin version rkbin's own
#     RKTRUST/RK3568TRUST.ini references, canonical for this SoC)
# U-Boot's make opts append this BL31= after TF-A's, so rkbin wins.
BR2_PACKAGE_ROCKCHIP_RKBIN=y
BR2_PACKAGE_ROCKCHIP_RKBIN_TPL_FILENAME="bin/rk35/rk3568_ddr_1560MHz_v1.18.bin"
BR2_PACKAGE_ROCKCHIP_RKBIN_BL31_FILENAME="bin/rk35/rk3568_bl31_v1.43.elf"

# Init system
BR2_INIT_BUSYBOX=y
BR2_ROOTFS_DEVICE_CREATION_DYNAMIC_DEVTMPFS=y

# Root filesystem
BR2_TARGET_ROOTFS_EXT2=y
BR2_TARGET_ROOTFS_EXT2_4=y
BR2_TARGET_ROOTFS_EXT2_SIZE="500M"
# BR2_TARGET_ROOTFS_TAR is not set

# System configuration
BR2_TARGET_GENERIC_HOSTNAME="linxdot"
BR2_TARGET_GENERIC_ISSUE="Welcome to OpenLinxdot"
BR2_TARGET_GENERIC_ROOT_PASSWD="linxdot"
BR2_SYSTEM_DHCP="eth0"
BR2_ROOTFS_OVERLAY="$(BR2_EXTERNAL_LINXDOT_PATH)/board/linxdot/overlay"
BR2_ROOTFS_POST_BUILD_SCRIPT="$(BR2_EXTERNAL_LINXDOT_PATH)/board/linxdot/post-build.sh"
BR2_ROOTFS_POST_IMAGE_SCRIPT="$(BR2_EXTERNAL_LINXDOT_PATH)/board/linxdot/post-image.sh"
BR2_ROOTFS_POST_SCRIPT_ARGS="$(BR2_EXTERNAL_LINXDOT_PATH)"

# Packages — Docker
BR2_PACKAGE_DOCKER_ENGINE=y
BR2_PACKAGE_DOCKER_ENGINE_EXPERIMENTAL=y
BR2_PACKAGE_DOCKER_CLI=y
BR2_PACKAGE_DOCKER_COMPOSE_V1=y

# Packages — networking
BR2_PACKAGE_DROPBEAR=y
BR2_PACKAGE_IPTABLES=y
BR2_PACKAGE_BRIDGE_UTILS=y
BR2_PACKAGE_DHCPCD=y
BR2_PACKAGE_WPA_SUPPLICANT=y
BR2_PACKAGE_WPA_SUPPLICANT_NL80211=y
BR2_PACKAGE_WPA_SUPPLICANT_AUTOSCAN=y
BR2_PACKAGE_CA_CERTIFICATES=y
BR2_PACKAGE_NTP=y
BR2_PACKAGE_NTP_NTPD=y

# Packages — filesystem / utilities
BR2_PACKAGE_E2FSPROGS=y
BR2_PACKAGE_E2FSPROGS_RESIZE2FS=y
BR2_PACKAGE_UTIL_LINUX=y
BR2_PACKAGE_UTIL_LINUX_MOUNT=y
BR2_PACKAGE_UTIL_LINUX_FINDMNT=y
BR2_PACKAGE_NANO=y

# Packages — OTA
BR2_PACKAGE_LIBUBOOTENV=y
BR2_PACKAGE_LIBCONFIG=y
BR2_PACKAGE_OPENSSL=y
BR2_PACKAGE_SWUPDATE=y
BR2_PACKAGE_SWUPDATE_CONFIG="$(BR2_EXTERNAL_LINXDOT_PATH)/board/linxdot/swupdate/swupdate.config"
BR2_PACKAGE_LIBCURL=y
BR2_PACKAGE_LIBCURL_CURL=y

# Packages — system
BR2_PACKAGE_CGROUPFS_MOUNT=y

# Host tools
BR2_PACKAGE_HOST_GENIMAGE=y
BR2_PACKAGE_HOST_DOSFSTOOLS=y
BR2_PACKAGE_HOST_MTOOLS=y
BR2_PACKAGE_HOST_UBOOT_TOOLS=y

# ccache for faster rebuilds
BR2_CCACHE=y
```

## package/docker-compose-v1/Config.in
```kconfig
config BR2_PACKAGE_DOCKER_COMPOSE_V1
	bool "docker-compose-v1"
	depends on BR2_aarch64
	help
	  Docker Compose v2 static binary for aarch64.
	  Installed as /usr/bin/docker-compose for v1 CLI compatibility.

	  https://github.com/docker/compose
```
